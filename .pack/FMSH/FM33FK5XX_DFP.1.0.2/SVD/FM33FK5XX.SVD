# FM33FK5XX register map
File version: 1.0
CPU: Cortex-M33 r1p0, little endian, MPU, FPU, 3 interrupt priority bits
Registers are 32-bit, read-write, reset 0x0 unless marked. A register's access mark holds for its fields unless they carry their own. Offsets are from the block's base; lines under a group give offsets from that group; [hi:lo] are bit positions; {n}, {i} and the like mark numbered series; 'fields as' and 'values as' point back to an identical list; <NAME> marks a mode.

## Memory map
0x40000000 SCU size 0x3C — SCU module information
0x40000400 DMA size 0x320 — DMA module information
0x40000C00 GPIOA size 0x30 — GPIOA module information
0x40000C40 GPIOB size 0x30 — GPIOB module information
0x40000C80 GPIOC size 0x30
0x40000CC0 GPIOD size 0x30
0x40000D00 GPIOE size 0x30
0x40000D40 GPIOF size 0x30
0x40000DC0 GPIO size 0x144 — GPIO module information
0x40001000 FLS size 0x24 — FLS module information
0x40001400 EPSC size 0x5C — EPSC module information
0x40002000 PMU size 0x84 — PMU module information
0x40002400 CMU size 0x68 — CMU module information
0x40002800 RMU size 0x24 — RMU module information
0x40002C00 SFU size 0x10 — SFU module information
0x40010000 SPI4 size 0x28
0x40010400 SPI3 size 0x28
0x40010800 SPI2 size 0x28
0x40011000 EPWM0 size 0x100 — EPWM0 module information
0x40011100 EPWM1 size 0x100
0x40011200 EPWM2 size 0x100
0x40011300 EPWM3 size 0x100
0x40011800 WWDT size 0x18 — WWDT module information
0x40011C00 UART0 size 0x84 — UART0 module information
0x40012000 UART1 size 0x3C — UART1 module information
0x40013800 GPTIM0 size 0x100 — GPTIM0 module information
0x40013C00 GPTIM1 size 0x100
0x40014000 GPTIM2 size 0x100
0x40014C00 I2CSMB2 size 0x34
0x40015000 I2C0 size 0x24 — I2C0 module information
0x40015400 I2C1 size 0x24
0x40015800 I2CSMB0 size 0x34 — I2CSMB0 module information
0x40015C00 I2CSMB1 size 0x34
0x40016000 UART6 size 0x3C
0x40016400 UART7 size 0x3C
0x40016800 UART4 size 0x3C
0x40016C00 UART5 size 0x3C
0x40017400 UART2 size 0x3C
0x40017800 UART3 size 0x3C
0x40017C00 UART size 0x54 — UART module information
0x40018000 CRC size 0x20 — CRC module information
0x40018400 ATIM0 size 0x100 — ATIM0 module information
0x40018C00 SPI1 size 0x28
0x40019000 SPI0 size 0x28 — SPI0 module information
0x40019400 CAN size 0x110 — CAN module information
0x40019800 FDCAN size 0x22C — FDCAN module information
0x4001AC00 ADC size 0xC8 — ADC module information
0x4001B000 ATIM1 size 0x100
0x4001B400 BSTIM16 size 0x30 — BSTIM16 module information
0x4001B800 AES size 0x54 — AES module information
0x4001BC00 RNG size 0x20 — RNG module information
0x4001DC00 PGL size 0x2C — PGL module information
0x4001EC00 CDIF size 0x8 — CDIF module information
0x4001F000 RTCB size 0x84 — RTCB module information
0x4001F800 VAO size 0x41C — VAO module information
0x40020000 LPTIM16 size 0x28 — LPTIM16 module information
0x40020400 LPUART0 size 0x1C — LPUART0 module information
0x40020800 LPUART1 size 0x1C
0x40021000 IWDT size 0x18 — IWDT module information
0x40021400 SVD size 0x14 — SVD module information
0x40021800 DAC0 size 0x20 — DAC0 module information
0x40021C00 DAC1 size 0x20
0x40022400 COMP size 0x18 — COMP module information
0x40022800 OPA0 size 0xC — OPA0 module information
0x40022820 OPA1 size 0xC
0x50000000 USB size 0xE04 — USB module information
0x50010000 USBPHY size 0x10 — USBPHY module information
0xE0044000 QSPI size 0x28 — QSPI module information

## Interrupts
0 WWDT — WWDT interrupt
1 SVD — SVD interrupt
3 IWDT — IWDT interrupt
5 CMU — CMU interrupt
8 ADC — ADC interrupt
9 DAC1 — DAC1 interrupt
11 SPI0 — SPI0 interrupt
12 SPI1 — SPI1 interrupt
13 SPI2 — SPI2 interrupt
14 SPI3 — SPI3 interrupt
15 SPI4 — SPI4 interrupt
{n+18} UART{n} (n=0..7) — UART{n} interrupt
29 LPUART0 — LPUART0 interrupt
30 LPUART1 — LPUART1 interrupt
32 EXTIA (GPIOA) — EXTIA interrupt
33 EXTIB (GPIOB) — EXTIB interrupt
34 EXTIC (GPIOC) — EXTIC interrupt
35 EXTID (GPIOD) — EXTID interrupt
36 EXTIE (GPIOE) — EXTIE interrupt
37 EXTIF (GPIOF) — EXTIF interrupt
38 I2CM0 (I2C0) — I2CM0 interrupt
39 I2CM1 (I2C1) — I2CM1 interrupt
40 I2CSMB0 — I2CSMB0 interrupt
41 I2CSMB1 — I2CSMB1 interrupt
42 I2CSMB2 — I2CSMB2 interrupt
46 AES — AES interrupt
50 DMA — DMA interrupt
51 WKUPX (GPIO) — WKUPX interrupt
53 COMPX (COMP) — COMPX interrupt
56 FDCAN — FDCAN interrupt
60 LPTIM16 — LPTIM16 interrupt
64 ATIM0 — ATIM0 interrupt
65 ATIM1 — ATIM1 interrupt
68 GPTIM0 — GPTIM0 interrupt
69 GPTIM1 — GPTIM1 interrupt
70 GPTIM2 — GPTIM2 interrupt
72 EPWM1 — EPWM1 interrupt
73 EPWM1_TZ (EPWM1) — EPWM1_TZ interrupt
74 EPWM2 — EPWM2 interrupt
75 EPWM2_TZ (EPWM2) — EPWM2_TZ interrupt
76 EPWM3 — EPWM3 interrupt
77 EPWM3_TZ (EPWM3) — EPWM3_TZ interrupt
83 USB — USB interrupt
85 EPSC — EPSC interrupt
